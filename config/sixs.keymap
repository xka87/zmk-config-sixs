#include <behaviors.dtsi>
#include <dt-bindings/zmk/keys.h>

/ {
    keymap {
        compatible = "zmk,keymap";

        default_layer {
            bindings = <
&kp KP_N7  &kp KP_N8  &sys_reset  &kp KP_N4  &kp KP_N5
            >;
        };
    };
};
